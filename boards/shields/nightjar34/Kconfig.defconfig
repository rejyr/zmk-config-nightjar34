## boards/shields/nightjar34/Kconfig.defconfig
```kconfig
# Copyright (c) 2026 Jerry Wang
# SPDX-License-Identifier: MIT

if SHIELD_NIGHTJAR34_LEFT

config ZMK_KEYBOARD_NAME
    default "nightjar34"

config ZMK_SPLIT_ROLE_CENTRAL
    default y

endif

if SHIELD_NIGHTJAR34_LEFT || SHIELD_NIGHTJAR34_RIGHT

config ZMK_SPLIT
    default y

endif
```

## boards/shields/nightjar34/Kconfig.shield
```kconfig
# Copyright (c) 2026 Jerry Wang
# SPDX-License-Identifier: MIT

config SHIELD_NIGHTJAR34_LEFT
    def_bool $(shields_list_contains,nightjar34_left)

config SHIELD_NIGHTJAR34_RIGHT
    def_bool $(shields_list_contains,nightjar34_right)
```

## config/west.yml
```yaml
manifest:
  defaults:
    # revision: v0.3
    remote: urob
    revision: main
  remotes:
    - name: urob
      url-base: https://github.com/urob
    - name: zmkfirmware
      url-base: https://github.com/zmkfirmware
  projects:
    - name: zmk
      remote: zmkfirmware
      import: app/west.yml

    # ZMK modules
    - name: zmk-adaptive-key
      path: modules/zmk/adaptive-key
      revision: e5b335a7b1076cb122582f5a892b118b02a3be34 # main (7/09/2026)
    - name: zmk-auto-layer
      path: modules/zmk/auto-layer
      revision: 62c201934711369d50a28df12e1d055d05cb6460 # main (7/09/2026)
    - name: zmk-helpers
      path: modules/zmk/helpers
      revision: bc114546392b4615ac90a99140eaf21dde31209d # main (7/09/2026)
    - name: zmk-leader-key
      path: modules/zmk/leader-key
      revision: e894d9afa5164b7fff641db4194fc3d4d6e84bbb # main (7/09/2026)
    - name: zmk-tri-state
      path: modules/zmk/tri-state
      revision: 2007896c6d5bfb519e8babccf8633841c5647d8b # main (7/09/2026)
    - name: zmk-unicode
      path: modules/zmk/unicode
      revision: 1a6dbc797a46c4a61c3c71a7a9d013a5d5aee49e # main (7/09/2026)

    # Only source necessary Zephyr modules. Remove this entire section to restore
    # the default (needed for less common hardware).
    # - name: zephyr
    #   remote: zmkfirmware
      # revision: 58a5874a446ace2893a196848282d271a551e512 # v4.1.0+zmk-fixes
    #   clone-depth: 1
    #   import:
    #     name-allowlist:
    #       - cmsis
    #       - hal_nordic
    #       - hal_rpi_pico
    #       - hal_stm32
    #       - mbedtls
    #       - tinycrypt

  self:
    path: config
```
